## config/boards/shields/hillside46/Kconfig.defconfig
```kconfig
# Copyright (c) 2021-2022 The ZMK Contributors
# SPDX-License-Identifier: MIT

if SHIELD_HILLSIDE46_LEFT

config ZMK_KEYBOARD_NAME
    default "Hillside46"

config ZMK_SPLIT_BLE_ROLE_CENTRAL
    default y

endif

if SHIELD_HILLSIDE46_LEFT || SHIELD_HILLSIDE46_RIGHT

config ZMK_SPLIT
    default y

config ZMK_USB
    default y
endif

if ZMK_DISPLAY

config I2C
    default y

config SSD1306
    default y

endif # ZMK_DISPLAY

endif # left || right
```
